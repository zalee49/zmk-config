## config/west.yml
```yaml
manifest:
  remotes:
    - name: zmkfirmware
      url-base: https://github.com/zmkfirmware
    - name: splitkb
      url-base: https://github.com/splitkb
  projects:
    - name: zmk
      remote: zmkfirmware
      revision: main
      import: app/west.yml
    - name: zmk-aurora-lily58
      remote: splitkb
      revision: main
  self:
    path: config
```
